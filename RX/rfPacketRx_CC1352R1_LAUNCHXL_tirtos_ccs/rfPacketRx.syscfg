/**
 * @cliArgs --board "/ti/boards/CC1352R1_LAUNCHXL" --product "simplelink_cc13x2_26x2_sdk@4.40.04.04"
 * @versions {"data":"2021010520","timestamp":"2021010520","tool":"1.7.0+1746","templates":null}
 */

/**
 * Import the modules used in this configuration.
 */
const CCFG        = scripting.addModule("/ti/devices/CCFG");
const custom      = scripting.addModule("/ti/devices/radioconfig/custom");
const rfdesign    = scripting.addModule("/ti/devices/radioconfig/rfdesign");
const Display     = scripting.addModule("/ti/display/Display", {}, false);
const Display1    = Display.addInstance();
const GPIO        = scripting.addModule("/ti/drivers/GPIO");
const GPIO1       = GPIO.addInstance();
const RF          = scripting.addModule("/ti/drivers/RF");
const RTOS        = scripting.addModule("/ti/drivers/RTOS");
const UART        = scripting.addModule("/ti/drivers/UART", {}, false);
const UART2       = UART.addInstance();
const tiUtilsRtos = scripting.addModule("/ti/utils/RTOS");

/**
 * Write custom configuration values to the imported modules.
 */
CCFG.enableBootloader         = true;
CCFG.enableBootloaderBackdoor = true;
CCFG.dioBootloaderBackdoor    = 15;
CCFG.levelBootloaderBackdoor  = "Active low";
CCFG.forceVddr                = true;
CCFG.ccfgTemplate.$name       = "ti_devices_CCFGTemplate0";

custom.prop8                                              = ["custom868"];
custom.radioConfigcustom868.phyType868                    = "2gfsk50kbps";
custom.radioConfigcustom868.$name                         = "RF_Custom_Setting";
custom.radioConfigcustom868.codeExportConfig.$name        = "ti_devices_radioconfig_code_export_param0";
custom.radioConfigcustom868.codeExportConfig.symGenMethod = "Legacy";

Display1.$name                    = "Display";
Display1.uart.$name               = "CONFIG_UART_1";
Display1.uart.txPinInstance.$name = "CONFIG_PIN_2";
Display1.uart.rxPinInstance.$name = "CONFIG_PIN_3";

GPIO1.$hardware         = system.deviceData.board.components.LED_RED;
GPIO1.$name             = "CONFIG_GPIO_RLED";
GPIO1.pinInstance.$name = "CONFIG_PIN_RLED";

UART2.$name               = "CONFIG_UART_0";
UART2.$hardware           = system.deviceData.board.components.XDS110UART;
UART2.txPinInstance.$name = "CONFIG_PIN_0";
UART2.rxPinInstance.$name = "CONFIG_PIN_1";

/**
 * Pinmux solution for unlocked pins/peripherals. This ensures that minor changes to the automatic solver in a future
 * version of the tool will not impact the pinmux you originally saw.  These lines can be completely deleted in order to
 * re-solve from scratch.
 */
Display1.uart.uart.$suggestSolution       = "UART1";
Display1.uart.uart.txPin.$suggestSolution = "boosterpack.32";
Display1.uart.uart.rxPin.$suggestSolution = "boosterpack.18";
GPIO1.gpioPin.$suggestSolution            = "boosterpack.39";
UART2.uart.$suggestSolution               = "UART0";
UART2.uart.txPin.$suggestSolution         = "boosterpack.4";
UART2.uart.rxPin.$suggestSolution         = "boosterpack.3";
